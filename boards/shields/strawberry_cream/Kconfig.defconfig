## boards/shields/strawberry_cream/Kconfig.defconfig
```kconfig
if SHIELD_STRAWBERRY_CREAM

# Name must be less than 16 characters long!
config ZMK_KEYBOARD_NAME
    default "Strawberry Cream"

endif
```

## boards/shields/strawberry_cream/Kconfig.shield
```kconfig
# No whitespace after the comma or in your keyboard name!
config SHIELD_STRAWBERRY_CREAM
    def_bool $(shields_list_contains,strawberry_cream)
```
