#include <behaviors.dtsi>
#include <dt-bindings/zmk/keys.h>

/ {
    keymap {
        compatible = "zmk,keymap";

        default_layer {
            bindings = <
                &kp B
                &kp E
                &kp LS(LC(N))
                &kp I
                &kp L
                &kp G
                &kp LC(Z)
                &kp LS(LC(Z))
                &kp COMMA
                &kp LEFT_BRACKET
                &kp RIGHT_BRACKET
            >;
        };
        sensors: sensors {
        compatible = "zmk,keymap-sensors";
        sensors = <&encoder1>;
        triggers-per-rotation = <20>;
    };
    };
};
